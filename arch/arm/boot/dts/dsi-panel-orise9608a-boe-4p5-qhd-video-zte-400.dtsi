/* Copyright (c) 2012, Code Aurora Forum. All rights reserved.
 *
 * This program is free software; you can redistribute it and/or modify
 * it under the terms of the GNU General Public License version 2 and
 * only version 2 as published by the Free Software Foundation.
 *
 * This program is distributed in the hope that it will be useful,
 * but WITHOUT ANY WARRANTY; without even the implied warranty of
 * MERCHANTABILITY or FITNESS FOR A PARTICULAR PURPOSE.  See the
 * GNU General Public License for more details.
 */

/*---------------------------------------------------------------------------
 * This file is autogenerated file using gcdb parser. Please do not edit it.
 * Update input XML file to add a new entry or update variable in this file
 * VERSION = "1.0"
 *---------------------------------------------------------------------------*/
&mdss_mdp {

		dsi_orise9608a_boe_qhd_vid: qcom,mdss_dsi_orise9608a_boe_4p5_qhd_video_400 {
		
		qcom,mdss-dsi-panel-name = "zteBOE(OTM9608A)_540*960_4.5Inch";
		
		qcom,cont-splash-enabled;
		zte,lcd-product = <400>;
		
		qcom,mdss-dsi-panel-controller = <&mdss_dsi0>;
		qcom,mdss-dsi-panel-type = "dsi_video_mode";
		qcom,mdss-dsi-panel-destination = "display_1";
		qcom,mdss-dsi-panel-framerate = <60>;
		qcom,mdss-dsi-virtual-channel-id = <0>;
		qcom,mdss-dsi-stream = <0>;
		qcom,mdss-dsi-panel-width = <540>;
		qcom,mdss-dsi-panel-height = <960>;
		qcom,mdss-dsi-h-front-porch = <80>;
		qcom,mdss-dsi-h-back-porch = <80>;
		qcom,mdss-dsi-h-pulse-width = <8>;
		qcom,mdss-dsi-h-sync-skew = <0>;
		qcom,mdss-dsi-v-front-porch = <32>;
		qcom,mdss-dsi-v-back-porch = <32>;		
		qcom,mdss-dsi-v-pulse-width = <4>;
		qcom,mdss-dsi-h-left-border = <0>;
		qcom,mdss-dsi-h-right-border = <0>;
		qcom,mdss-dsi-v-top-border = <0>;
		qcom,mdss-dsi-v-bottom-border = <0>;
		qcom,mdss-dsi-bpp = <24>;
		qcom,mdss-dsi-color-order = <0>;
		qcom,mdss-dsi-underflow-color = <0xff>;
		qcom,mdss-dsi-border-color = <0>;		
		
		qcom,mdss-dsi-h-sync-pulse = <0>;
		qcom,mdss-dsi-traffic-mode = <1>;
		qcom,mdss-dsi-lane-map ="lane_map_3012";
		qcom,mdss-dsi-bllp-eof-power-mode;
		qcom,mdss-dsi-bllp-power-mode;
		qcom,mdss-dsi-lane-0-state;
		qcom,mdss-dsi-lane-1-state;
		qcom,mdss-dsi-panel-timings = [89 1F 13 00 36 40 19 23  25 03 04 A0];
		qcom,mdss-dsi-t-clk-post = <0x22>;
		qcom,mdss-dsi-t-clk-pre = <0x3d>;
		qcom,mdss-dsi-bl-min-level = <1>;
		qcom,mdss-dsi-bl-max-level = <31>;
		qcom,mdss-dsi-dma-trigger = <0x04>;
		qcom,mdss-dsi-mdp-trigger = <0x0>;
		qcom,mdss-dsi-bl-pmic-control-type = "bl_ctrl_gpio";
		qcom,mdss-dsi-bl-cmd-gpio = <&msmgpio 23 0>;
		qcom,mdss-dsi-reset-sequence = <1 20>, <0 10>, <1 20>;
		qcom,mdss-dsi-on-command = [
				39 01 00 00 00 00 02 00 00
				39 01 00 00 00 00 04 ff 96 08 01
				39 01 00 00 00 00 02 00 80
				39 01 00 00 00 00 03 ff 96 08
				39 01 00 00 00 00 02 00 00
				39 01 00 00 00 00 02 a0 00			
				39 01 00 00 00 00 02 00 80
				39 01 00 00 00 00 06 b3 00 00 00 21 00
				39 01 00 00 00 00 02 00 92
				39 01 00 00 00 00 02 b3 01
				39 01 00 00 00 00 02 00 c0
				39 01 00 00 00 00 02 b3 11
				39 01 00 00 00 00 02 00 80  
				39 01 00 00 00 00 0a c0 00 48 00 10 08 00 48 10 10 
				39 01 00 00 00 00 02 00 92
				39 01 00 00 00 00 0a c0 00 35 00 38 c0 00 17 00 1a
				39 01 00 00 00 00 02 00 a2 
				39 01 00 00 00 00 04 c0 01 10 00
				39 01 00 00 00 00 02 00 b3
				39 01 00 00 00 00 03 c0 00 50
				39 01 00 00 00 00 02 00 81   
				39 01 00 00 00 00 02 c1 77 //  55-60hz 66-65hz  77-70hz
				39 01 00 00 00 00 02 00 a0  
				39 01 00 00 00 00 02 c1 04
				39 01 00 00 00 00 02 00 80  
				39 01 00 00 00 00 07 c4 00 84 fa 00 84 fa
				39 01 00 00 00 00 02 00 a0 
				39 01 00 00 00 00 09 c4 33 09 90 2b 33 09 90 54
				39 01 00 00 00 00 02 00 80  
				39 01 00 00 00 00 05 c5 08 00 90 11
				39 01 00 00 00 00 02 00 90 
				39 01 00 00 00 00 08 c5 96 08 00 77 34 34 34
				39 01 00 00 00 00 02 00 a0   
				39 01 00 00 00 00 08 c5 96 08 00 77 34 34 34
				39 01 00 00 00 00 02 00 b0  
				39 01 00 00 00 00 03 c5 04 58
				39 01 00 00 00 00 02 00 80  
				39 01 00 00 00 00 02 c6 64
				39 01 00 00 00 00 02 00 b0  
				39 01 00 00 00 00 06 c6 03 10 00 1f 12
				39 01 00 00 00 00 02 00 e1 
				39 01 00 00 00 00 02 c0 9f
				39 01 00 00 00 00 02 00 00 
				39 01 00 00 00 00 02 d0 01
				39 01 00 00 00 00 02 00 00 
				39 01 00 00 00 00 03 d1 01 01
				39 01 00 00 00 00 02 00 b7 
				39 01 00 00 00 00 02 b0 10   
				39 01 00 00 00 00 02 00 c0 
				39 01 00 00 00 00 02 b0 55
				39 01 00 00 00 00 02 00 b1
				39 01 00 00 00 00 03 b0 03 06
				39 01 00 00 00 00 02 00 80
				39 01 00 00 00 00 0b cb 00 00 00 00 00 00 00 00 00 00
				39 01 00 00 00 00 02 00 90
				39 01 00 00 00 00 10 cb 00 00 00 00 00 00 00 00 00 00 00 00 00 00 00 
				39 01 00 00 00 00 02 00 a0
				39 01 00 00 00 00 10 cb 00 00 00 00 00 00 00 00 00 00 00 00 00 00 00
				39 01 00 00 00 00 02 00 b0
				39 01 00 00 00 00 0b cb 00 00 00 00 00 00 00 00 00 00
				39 01 00 00 00 00 02 00 c0
				39 01 00 00 00 00 10 cb 00 00 04 04 04 04 04 00 00 00 00 00 00 00 00
				39 01 00 00 00 00 02 00 d0
				39 01 00 00 00 00 10 cb 00 00 00 00 00 00 00 04 04 04 04 04 00 00 00
				39 01 00 00 00 00 02 00 e0
				39 01 00 00 00 00 0b cb 00 00 00 00 00 00 00 00 00 00
				39 01 00 00 00 00 02 00 f0
				39 01 00 00 00 00 0b cb ff ff ff ff ff ff ff ff ff ff
				39 01 00 00 00 00 02 00 80
				39 01 00 00 00 00 0b cc 00 00 0b 09 01 25 26 00 00 00
				39 01 00 00 00 00 02 00 90  
				39 01 00 00 00 00 10 cc 00 00 00 00 00 00 00 00 00 00 00 00 0c 0a 02
				39 01 00 00 00 00 02 00 a0 
				39 01 00 00 00 00 10 cc 25 26 00 00 00 00 00 00 00 00 00 00 00 00 00
				39 01 00 00 00 00 02 00 b0 
				39 01 00 00 00 00 0b cc 00 00 0a 0c 02 26 25 00 00 00
				39 01 00 00 00 00 02 00 c0 
				39 01 00 00 00 00 10 cc 00 00 00 00 00 00 00 00 00 00 00 00 09 0b 01
				39 01 00 00 00 00 02 00 d0 
				39 01 00 00 00 00 10 cc 26 25 00 00 00 00 00 00 00 00 00 00 00 00 00
				39 01 00 00 00 00 02 00 80 
				39 01 00 00 00 00 0d ce 85 01 00 84 01 00 0f 00 00 0f 00 00
				39 01 00 00 00 00 02 00 90 
				39 01 00 00 00 00 0f ce f0 00 00 f0 00 00 f0 00 00 f0 00 00 00 00
				39 01 00 00 00 00 02 00 a0 
				39 01 00 00 00 00 0f ce 18 02 03 c2 86 00 22 18 01 03 c4 86 00 22
				39 01 00 00 00 00 02 00 b0  
				39 01 00 00 00 00 0f ce 18 04 03 c3 86 00 22 18 03 03 c5 86 00 22
				39 01 00 00 00 00 02 00 c0  
				39 01 00 00 00 00 0f ce f0 00 00 10 00 00 00 f0 00 00 10 00 00 00
				39 01 00 00 00 00 02 00 d0  
				39 01 00 00 00 00 0f ce f0 00 00 10 00 00 00 f0 00 00 10 00 00 00
				39 01 00 00 00 00 02 00 80
				39 01 00 00 00 00 0f cf f0 00 00 10 00 00 00 f0 00 00 10 00 00 00
				39 01 00 00 00 00 02 00 90
				39 01 00 00 00 00 0f cf f0 00 00 10 00 00 00 f0 00 00 10 00 00 00
				39 01 00 00 00 00 02 00 a0
				39 01 00 00 00 00 0f cf f0 00 00 10 00 00 00 f0 00 00 10 00 00 00
				39 01 00 00 00 00 02 00 b0
				39 01 00 00 00 00 0f cf f0 00 00 10 00 00 00 f0 00 00 10 00 00 00
				39 01 00 00 00 00 02 00 c0
				39 01 00 00 00 00 0b cf 02 02 20 20 00 00 01 02 00 00 
				39 01 00 00 00 00 02 00 80
				39 01 00 00 00 00 02 d6 00
				39 01 00 00 00 00 02 00 00
				39 01 00 00 00 00 02 d7 00
				39 01 00 00 00 00 02 00 00
				39 01 00 00 00 00 03 d8 75 75
				39 01 00 00 00 00 02 00 00
				39 01 00 00 00 00 02 d9 5d
				39 01 00 00 00 00 02 00 00
				39 01 00 00 00 00 09 e1 00 08 0e 0d 06 10 0b 0a
				39 01 00 00 00 00 09 e1 03 06 0a 05 0f 11 0c 00
				39 01 00 00 00 00 02 00 00
				39 01 00 00 00 00 09 e2 00 09 0d 0d 06 10 0b 0a
				39 01 00 00 00 00 09 e2 03 06 09 05 0f 12 0c 00
				39 01 00 00 00 00 02 00 00
				39 01 00 00 00 00 04 ff ff ff ff
				39 01 00 00 00 00 02 00 00
				39 01 00 00 00 00 02 36 d0
				05 01 00 00 78 00 02 11 00
				05 01 00 00 78 00 02 29 00
				39 01 00 00 00 00 02 35 00			//te
				39 01 00 00 00 00 03 44 00 d0		//te relative
				];
		qcom,mdss-dsi-on-command-state = "dsi_lp_mode";
		qcom,mdss-dsi-off-command = [05 01 00 00 32 00 02 28 00
					05 01 00 00 78 00 02 10 00];
		qcom,mdss-dsi-off-command-state = "dsi_hs_mode";
	};
};
