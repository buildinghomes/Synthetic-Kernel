/* Copyright (c) 2012, Code Aurora Forum. All rights reserved.
 *
 * This program is free software; you can redistribute it and/or modify
 * it under the terms of the GNU General Public License version 2 and
 * only version 2 as published by the Free Software Foundation.
 *
 * This program is distributed in the hope that it will be useful,
 * but WITHOUT ANY WARRANTY; without even the implied warranty of
 * MERCHANTABILITY or FITNESS FOR A PARTICULAR PURPOSE.  See the
 * GNU General Public License for more details.
 */

/*---------------------------------------------------------------------------
 * This file is autogenerated file using gcdb parser. Please do not edit it.
 * Update input XML file to add a new entry or update variable in this file
 * VERSION = "1.0"
 *---------------------------------------------------------------------------*/
&mdss_mdp {


	dsi_nt35516_tm_qhd_vid: qcom,mdss_dsi_nt35516_tm_4p5_qhd_video_401 {
		
		qcom,mdss-dsi-panel-name = "zteTM(NT35516)_540*960_4.5Inch";		
		
		qcom,cont-splash-enabled;
		zte,lcd-product = <401>;
		

		qcom,mdss-dsi-panel-controller = <&mdss_dsi0>;
		qcom,mdss-dsi-panel-type = "dsi_video_mode";
		qcom,mdss-dsi-panel-destination = "display_1";
		qcom,mdss-dsi-panel-framerate = <60>;
		qcom,mdss-dsi-virtual-channel-id = <0>;
		qcom,mdss-dsi-stream = <0>;
		qcom,mdss-dsi-panel-width = <540>;
		qcom,mdss-dsi-panel-height = <960>;
		qcom,mdss-dsi-h-front-porch = <80>;
		qcom,mdss-dsi-h-back-porch = <80>;
		qcom,mdss-dsi-h-pulse-width = <8>;
		qcom,mdss-dsi-h-sync-skew = <0>;
		
		qcom,mdss-dsi-v-front-porch = <32>;
		qcom,mdss-dsi-v-back-porch = <32>;
		qcom,mdss-dsi-v-pulse-width = <4>;
		qcom,mdss-dsi-h-left-border = <0>;
		qcom,mdss-dsi-h-right-border = <0>;
		qcom,mdss-dsi-v-top-border = <0>;
		qcom,mdss-dsi-v-bottom-border = <0>;
		qcom,mdss-dsi-bpp = <24>;
		qcom,mdss-dsi-color-order = <0>;
		qcom,mdss-dsi-underflow-color = <0xff>;
		qcom,mdss-dsi-border-color = <0>;
		
		qcom,mdss-dsi-h-sync-pulse = <0>;
		qcom,mdss-dsi-traffic-mode = <1>;
		qcom,mdss-dsi-lane-map ="lane_map_3012";
		qcom,mdss-dsi-bllp-eof-power-mode;
		qcom,mdss-dsi-bllp-power-mode;
		qcom,mdss-dsi-lane-0-state;
		qcom,mdss-dsi-lane-1-state;
		qcom,mdss-dsi-panel-timings = [89 1F 13 00 36 40 19 23  25 03 04 A0];
		qcom,mdss-dsi-t-clk-post = <0x22>;
		qcom,mdss-dsi-t-clk-pre = <0x3d>;
		qcom,mdss-dsi-bl-min-level = <1>;
		qcom,mdss-dsi-bl-max-level = <31>;
		qcom,mdss-dsi-dma-trigger = <0x04>;
		qcom,mdss-dsi-mdp-trigger = <0x0>;
		qcom,mdss-dsi-bl-pmic-control-type = "bl_ctrl_gpio";
		qcom,mdss-dsi-bl-cmd-gpio = <&msmgpio 23 0>;
		qcom,mdss-dsi-reset-sequence = <1 20>, <0 10>, <1 20>;
		qcom,mdss-dsi-on-command = [
				39 01 00 00 00 00 06 F0 55 AA 52 08 00
				39 01 00 00 00 00 04 B1 FC 00 00 
				39 01 00 00 00 00 02 B6 0B     
				39 01 00 00 00 00 03 B7 72 72
				39 01 00 00 00 00 05 B8 01 04 04 04
				39 01 00 00 00 00 02 BA 05
				39 01 00 00 00 00 04 BC 00 00 00
				39 01 00 00 00 00 04 BB 53 03 53
				39 01 00 00 00 00 02 C7 70
				39 01 00 00 00 00 07 C9 41 06 0D 3A 17 00
				39 01 00 00 00 00 0C CA 00 E4 E4 E4 E4 E4 E4 08 08 00 01
				39 01 00 00 00 00 02 3a 77
				39 01 00 00 00 00 02 36 d4
				39 01 00 00 00 00 06 f0 55 aa 52 08 01
				39 01 00 00 00 00 02 B0 0a
				39 01 00 00 00 00 02 B6 54
				39 01 00 00 00 00 02 B1 0a
				39 01 00 00 00 00 02 B7 34
				39 01 00 00 00 00 02 B2 00
				39 01 00 00 00 00 02 B8 30
				39 01 00 00 00 00 02 B3 0d
				39 01 00 00 00 00 02 B9 34
				39 01 00 00 00 00 02 B4 08
				39 01 00 00 00 00 02 Ba 24
				39 01 00 00 00 00 04 Bc 00 78 00
				39 01 00 00 00 00 04 Bd 00 78 00
				39 01 00 00 00 00 02 Be 3e
				39 01 00 00 00 00 05 d0 0a 10 0d 0f
				39 01 00 00 00 00 11 d1 00 00 00 74 00 c9 01 05 01 16 01 3e 01 66 01 95
				39 01 00 00 00 00 11 d2 01 b8 01 e5 02 1b 02 5d 02 93 02 95 02 c4 02 f8 //30
				39 01 00 00 00 00 11 d3 03 18 03 44 03 60 03 82 03 98 03 b5 03 db 03 f0
				39 01 00 00 00 00 05 d4 03 f7 03 f8
				39 01 00 00 00 00 11 d5 00 00 00 74 00 c9 01 05 01 16 01 3e 01 66 01 95
				39 01 00 00 00 00 11 d6 01 b8 01 e5 02 1b 02 5d 02 93 02 95 02 c4 02 f8
				39 01 00 00 00 00 11 d7 03 18 03 44 03 60 03 82 03 98 03 b5 03 db 03 f0
				39 01 00 00 00 00 05 d8 03 f7 03 f8
				39 01 00 00 00 00 11 d9 00 00 00 74 00 c9 01 05 01 16 01 3e 01 66 01 95
				39 01 00 00 00 00 11 dd 01 b8 01 e5 02 1b 02 5d 02 93 02 95 02 c4 02 f8
				39 01 00 00 00 00 11 de 03 18 03 44 03 60 03 82 03 98 03 b5 03 db 03 f0
				39 01 00 00 00 00 05 df 03 f7 03 f8							//40
				39 01 00 00 00 00 11 e0 00 00 00 74 00 c9 01 05 01 16 01 3e 01 66 01 95
				39 01 00 00 00 00 11 e1 01 b8 01 e5 02 1b 02 5d 02 93 02 95 02 c4 02 f8
				39 01 00 00 00 00 11 e2 03 18 03 44 03 60 03 82 03 98 03 b5 03 db 03 f0
				39 01 00 00 00 00 05 e3 03 f7 03 f8	
				39 01 00 00 00 00 11 e4 00 00 00 74 00 c9 01 05 01 16 01 3e 01 66 01 95
				39 01 00 00 00 00 11 e5 01 b8 01 e5 02 1b 02 5d 02 93 02 95 02 c4 02 f8
				39 01 00 00 00 00 11 e6 03 18 03 44 03 60 03 82 03 98 03 b5 03 db 03 f0
				39 01 00 00 00 00 05 e7 03 f7 03 f8
				39 01 00 00 00 00 11 e8 00 00 00 74 00 c9 01 05 01 16 01 3e 01 66 01 95
				39 01 00 00 00 00 11 e9 01 b8 01 e5 02 1b 02 5d 02 93 02 95 02 c4 02 f8
				39 01 00 00 00 00 11 ea 03 18 03 44 03 60 03 82 03 98 03 b5 03 db 03 f0
				39 01 00 00 00 00 05 eb 03 f7 03 f8				                          
				05 01 00 00 78 00 02 11 00 
				05 01 00 00 78 00 02 29 00
				];
		qcom,mdss-dsi-on-command-state = "dsi_lp_mode";
		qcom,mdss-dsi-off-command = [05 01 00 00 32 00 02 28 00
					05 01 00 00 78 00 02 10 00];
		qcom,mdss-dsi-off-command-state = "dsi_hs_mode";
	};
};
