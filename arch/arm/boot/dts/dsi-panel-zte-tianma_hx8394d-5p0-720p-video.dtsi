/* Copyright (c) 2012, Code Aurora Forum. All rights reserved.
 *
 * This program is free software; you can redistribute it and/or modify
 * it under the terms of the GNU General Public License version 2 and
 * only version 2 as published by the Free Software Foundation.
 *
 * This program is distributed in the hope that it will be useful,
 * but WITHOUT ANY WARRANTY; without even the implied warranty of
 * MERCHANTABILITY or FITNESS FOR A PARTICULAR PURPOSE.  See the
 * GNU General Public License for more details.
 */

/*---------------------------------------------------------------------------
 * This file is autogenerated file using gcdb parser. Please do not edit it.
 * Update input XML file to add a new entry or update variable in this file
 * VERSION = "1.0"
 *file name:panel_tianma_hx8394d_5p0_hd_video.h
 *author   :created by panmingdong at 20140819
 *when    			who(by)   			who(from) 			why
 *2014.08.19		panmingdong		  	yuhongchun			create
 
 *---------------------------------------------------------------------------*/
&mdss_mdp {

        dsi_lcd_panel_5p0_tm_hx8394d_hd: qcom,mdss_dsi_lcd_panel_5p0_tm_hx8394d_hd{
		
        qcom,mdss-dsi-panel-name =  "zteTM(HX8394D)BOE_720*1280_5.0Inch";             
		qcom,cont-splash-enabled;		
 		qcom,mdss-dsi-panel-controller = <&mdss_dsi0>;
		qcom,mdss-dsi-panel-type = "dsi_video_mode";
		qcom,mdss-dsi-panel-destination = "display_1";
		qcom,mdss-dsi-panel-framerate = <60>;
		qcom,mdss-dsi-virtual-channel-id = <0>;
		qcom,mdss-dsi-stream = <0>;
		qcom,mdss-dsi-panel-width = <720>;
		qcom,mdss-dsi-panel-height = <1280>;
		qcom,mdss-dsi-h-front-porch = <80>;
		qcom,mdss-dsi-h-back-porch = <80>;
		qcom,mdss-dsi-h-pulse-width = <20>;//<12>;
		qcom,mdss-dsi-h-sync-skew = <0>;
		qcom,mdss-dsi-v-front-porch = <6>;
		qcom,mdss-dsi-v-back-porch = <12>;		
		qcom,mdss-dsi-v-pulse-width = <4>;
		qcom,mdss-dsi-h-left-border = <0>;
		qcom,mdss-dsi-h-right-border = <0>;
		qcom,mdss-dsi-v-top-border = <0>;
		qcom,mdss-dsi-v-bottom-border = <0>;
		qcom,mdss-dsi-bpp = <24>;
		qcom,mdss-dsi-color-order = <0>;
		qcom,mdss-dsi-underflow-color = <0xff>;
		qcom,mdss-dsi-border-color = <0>;
		
		qcom,mdss-dsi-h-sync-pulse = <0>;
		qcom,mdss-dsi-traffic-mode = <1>;
		qcom,mdss-dsi-lane-map = <0>;
		qcom,mdss-dsi-bllp-eof-power-mode;
		qcom,mdss-dsi-bllp-power-mode;
		qcom,mdss-dsi-lane-0-state;
		qcom,mdss-dsi-lane-1-state;
		qcom,mdss-dsi-lane-2-state;
		qcom,mdss-dsi-lane-3-state;
		qcom,mdss-dsi-lp11-init;
		qcom,mdss-dsi-panel-timings =[6b 1a 10 00 3e 40 16 1e  15 03 04 a0];
		qcom,mdss-dsi-t-clk-post = <0x04>;
		qcom,mdss-dsi-t-clk-pre = <0x18>;
		qcom,mdss-dsi-bl-min-level = <1>;
		qcom,mdss-dsi-bl-max-level = <31>;
		qcom,mdss-dsi-dma-trigger = <0x04>;
		qcom,mdss-dsi-mdp-trigger = <0x0>;
		qcom,mdss-dsi-bl-pmic-control-type = "bl_ctrl_gpio";
		qcom,mdss-dsi-bl-cmd-gpio = <&msmgpio 33 0>;
		qcom,mdss-dsi-reset-sequence = <1 20>, <0 10>, <1 180>;//delay >180
		qcom,mdss-pan-physical-width-dimension = <64>;
		qcom,mdss-pan-physical-height-dimension = <113>;
                qcom,mdss-dsi-on-command= [

                             39 01 00 00 00 00 04 B9 FF 83 94
39 01 00 00 00 00 03 BA 33 83
39 01 00 00 00 00 10 B1 6C 10 11 17 04 11 F1 80 E8 95 23 80 C0 D2 18
39 01 00 00 00 00 0C B2 00 64 0E 0D 22 23 08 08 1C 4D 00
39 01 00 00 00 00 0D B4 00 FF 03 5A 03 5A 03 5A 03 64 03 64	            
39 01 00 00 00 00 04 BF 41 0E 01  
39 01 00 00 00 00 26 D3 00 0F 00 00 00 10 00 32 10 0D 00 00 32 10 00 00 00 32 10 00 00 00 36 03 11 09 37 00 00 37 00 00 00 00 0A 00 01
39 01 00 00 00 00 2D D5 02 03 00 01 06 07 04 05 20 21 22 23 18 18 18 18 18 18 18 18 18 18 18 18 18 18 18 18 18 18 18 18 18 18 18 18 18 18 24 25 18 18 19 19
39 01 00 00 00 00 2D D6 05 04 07 06 01 00 03 02 23 22 21 20 18 18 18 18 18 18 18 18 18 18 18 18 18 18 18 18 18 18 18 18 18 18 18 18 18 18 25 24 19 19 18 18
39 01 00 00 00 00 2B E0  00 0D 15 38 3B 3F 28 49 06 0A 0D 18 0F 13 16 13 14 08 13 16 1B 00 0D 15 38 3B 3F 28 49 06 0A 0D 18 0F 13 16 13 14 08 13 16 1B
39 01 00 00 00 00 02 CC 09
39 01 00 00 00 00 05 C7 00 00 00 C0
39 01 00 00 00 00 03 B6 8D 8D
39 01 00 00 00 00 03 C0 30 14
39 01 00 00 00 00 02 BC 07
39 01 00 00 00 00 01 11
39 01 00 00 00 00 01 29
39 01 00 00 00 00 02 35 00
39 01 00 00 00 00 02 51 FF
39 01 00 00 00 00 02 53 24
39 01 00 00 00 00 02 55 00
                              
                              05 01 00 00 C8 00 02 11 00 
                              
                              05 01 00 00 14 00 02 29 00 
                              
				];
                qcom,mdss-dsi-on-command-state = "dsi_lp_mode";
                qcom,mdss-dsi-off-command = [05 01 00 00 32 00 02 28 00
                                       05 01 00 00 78 00 02 10 00];
                qcom,mdss-dsi-off-command-state = "dsi_hs_mode";
        };
};






































































































































