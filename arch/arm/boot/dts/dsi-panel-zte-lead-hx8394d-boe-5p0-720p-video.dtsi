/* Copyright (c) 2012, Code Aurora Forum. All rights reserved.
 *
 * This program is free software; you can redistribute it and/or modify
 * it under the terms of the GNU General Public License version 2 and
 * only version 2 as published by the Free Software Foundation.
 *
 * This program is distributed in the hope that it will be useful,
 * but WITHOUT ANY WARRANTY; without even the implied warranty of
 * MERCHANTABILITY or FITNESS FOR A PARTICULAR PURPOSE.  See the
 * GNU General Public License for more details.
 */

/*---------------------------------------------------------------------------
 * This file is autogenerated file using gcdb parser. Please do not edit it.
 * Update input XML file to add a new entry or update variable in this file
 * VERSION = "1.0"
 *---------------------------------------------------------------------------*/
&mdss_mdp {

        dsi_lead_hx8394d_boe_720p_vid: qcom,mdss_dsi_lead_hx8394d_boe_5p0_720p_video{
		
        	qcom,mdss-dsi-panel-name =  "zteLEAD(HX8394D)BOE_720*1280_5.0Inch";             
		qcom,cont-splash-enabled;		
 		qcom,mdss-dsi-panel-controller = <&mdss_dsi0>;
		qcom,mdss-dsi-panel-type = "dsi_video_mode";
		qcom,mdss-dsi-panel-destination = "display_1";
		qcom,mdss-dsi-panel-framerate = <60>;
		qcom,mdss-dsi-virtual-channel-id = <0>;
		qcom,mdss-dsi-stream = <0>;
		qcom,mdss-dsi-panel-width = <720>;
		qcom,mdss-dsi-panel-height = <1280>;
		qcom,mdss-dsi-h-front-porch = <80>;
		qcom,mdss-dsi-h-back-porch = <80>;
		qcom,mdss-dsi-h-pulse-width = <20>;//<12>;
		qcom,mdss-dsi-h-sync-skew = <0>;
		qcom,mdss-dsi-v-front-porch = <6>;
		qcom,mdss-dsi-v-back-porch = <12>;		
		qcom,mdss-dsi-v-pulse-width = <4>;
		qcom,mdss-dsi-h-left-border = <0>;
		qcom,mdss-dsi-h-right-border = <0>;
		qcom,mdss-dsi-v-top-border = <0>;
		qcom,mdss-dsi-v-bottom-border = <0>;
		qcom,mdss-dsi-bpp = <24>;
		qcom,mdss-dsi-color-order = <0>;
		qcom,mdss-dsi-underflow-color = <0xff>;
		qcom,mdss-dsi-border-color = <0>;
		
		qcom,mdss-dsi-h-sync-pulse = <0>;
		qcom,mdss-dsi-traffic-mode = <1>;
		qcom,mdss-dsi-lane-map = <0>;
		qcom,mdss-dsi-bllp-eof-power-mode;
		qcom,mdss-dsi-bllp-power-mode;
		qcom,mdss-dsi-lane-0-state;
		qcom,mdss-dsi-lane-1-state;
		qcom,mdss-dsi-lane-2-state;
		qcom,mdss-dsi-lane-3-state;
		qcom,mdss-dsi-lp11-init;
		qcom,mdss-dsi-panel-timings =[6b 1a 10 00 3e 40 16 1e  15 03 04 a0];
		qcom,mdss-dsi-t-clk-post = <0x04>;
		qcom,mdss-dsi-t-clk-pre = <0x18>;
		qcom,mdss-dsi-bl-min-level = <1>;
		qcom,mdss-dsi-bl-max-level = <31>;
		qcom,mdss-dsi-dma-trigger = <0x04>;
		qcom,mdss-dsi-mdp-trigger = <0x0>;
		qcom,mdss-dsi-bl-pmic-control-type = "bl_ctrl_gpio";
		qcom,mdss-dsi-bl-cmd-gpio = <&msmgpio 33 0>;
		qcom,mdss-dsi-reset-sequence = <1 20>, <0 10>, <1 180>;//delay >180
		qcom,mdss-pan-physical-width-dimension = <64>;
		qcom,mdss-pan-physical-height-dimension = <113>;
                qcom,mdss-dsi-on-command= [

                              39 01 00 00 00 00 04 B9 FF 83 94                                         

                              39 01 00 00 00 00 09 BA 33 83  a0 6d b2 00 00 40    //20140604                                  

                              39 01 00 00 00 00 10 B1 6C 12 12 23 04 11 F1 80 99 9F 23 80 C0 D2 58                                 

                              39 01 00 00 00 00 0C B2 00 64 0E 0D 12 23 08 08 1C 4D 00                                 

                              39 01 00 00 00 00 0D B4 00 FF 57 58 57 58 57 58 01 6c 01 6c

                              39 01 00 00 00 00 02 BC 07 

                              39 01 00 00 00 00 04 BF 41 0E 01 

                              39 01 00 00 00 00 1F D3 00 00 00 00 00 10 10 32 10 02 00 02 32 13 C0 00 00 
                                                      32 10 08 00 00 47 04 04 04 47 04 00 47 

                              39 01 00 00 00 00 2D D5 00 01 02 03 04 05 06 07 20 21 22 23 18 18 18 18 18 18 18 18 18 18 
                                                      18 18 18 18 18 18 18 18 18 18 18 18 18 18 18 18 18 18 19 19 18 18 

                              39 01 00 00 00 00 2D D6 07 06 05 04 03 02 01 00 23 22 21 20 18 18 18 18 18 18 18 18 18 18 18 
                                                      18 18 18 18 18 18 18 18 18 18 18 18 18 18 18 18 18 18 18 19 19 

                              39 01 00 00 00 00 2B E0 00 08 0B 33 3A 3F 19 3D 06 09 0D 17 0E 12 14 13 14 07 12 19 1D 
                                                      00 07 0A 33 3A 3F 19 3D 07 09 0D 17 0F 12 15 12 13 06 13 1A 1E                                                                 

                              39 01 00 00 00 00 02 CC 09                             
                  
                              39 01 00 00 00 00 03 C0 30 14                             

                              39 01 00 00 00 00 05 C7 00 C0 40 C0 

                              39 01 00 00 00 00 03 B6 4a 4a        //vcom 

				  39 01 00 00 0a 00 02 B9 00   //end of cmd 20140604
                              
                              05 01 00 00 C8 00 02 11 00 
                              
                              05 01 00 00 14 00 02 29 00 
                              
				];
                qcom,mdss-dsi-on-command-state = "dsi_lp_mode";
                qcom,mdss-dsi-off-command = [05 01 00 00 32 00 02 28 00
                                       05 01 00 00 78 00 02 10 00];
                qcom,mdss-dsi-off-command-state = "dsi_hs_mode";
        };
};