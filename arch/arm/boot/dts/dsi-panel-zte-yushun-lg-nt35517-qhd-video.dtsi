/* Copyright (c) 2013, The Linux Foundation. All rights reserved.
 *
 * This program is free software; you can redistribute it and/or modify
 * it under the terms of the GNU General Public License version 2 and
 * only version 2 as published by the Free Software Foundation.
 *
 * This program is distributed in the hope that it will be useful,
 * but WITHOUT ANY WARRANTY; without even the implied warranty of
 * MERCHANTABILITY or FITNESS FOR A PARTICULAR PURPOSE.  See the
 * GNU General Public License for more details.
 */

/*---------------------------------------------------------------------------
 * This file is autogenerated file using gcdb parser. Please do not edit it.
 * Update input XML file to add a new entry or update variable in this file
 * VERSION = "1.0"
 *---------------------------------------------------------------------------*/
/*---------------------------------------------------------------------------*/
/* created by tang in 8/19/2014 for P892U12..                                                      
/*---------------------------------------------------------------------------*/
 
&mdss_mdp {
	dsi_yushun_qhd_video: qcom,zte-lg-nt35517-qhd-video {
		qcom,mdss-dsi-panel-name = "zteYUSHUN(NT35517)LG_540*960_5Inch";
		qcom,mdss-pan-physical-height-dimension = <110>;		
		qcom,mdss-pan-physical-width-dimension = <62>;		
		zte,lcd-proc-panel-name = "zteLG(NT35517)_540*960_5Inch";
		qcom,cont-splash-enabled;
		qcom,mdss-dsi-panel-controller = <&mdss_dsi0>;
		qcom,mdss-dsi-panel-type = "dsi_video_mode";
		qcom,mdss-dsi-panel-destination = "display_1";
		qcom,mdss-dsi-panel-framerate = <60>;
		qcom,mdss-dsi-virtual-channel-id = <0>;
		qcom,mdss-dsi-stream = <0>;
		qcom,mdss-dsi-panel-width = <540>;
		qcom,mdss-dsi-panel-height = <960>;
		qcom,mdss-dsi-h-front-porch = <48>;
		qcom,mdss-dsi-h-back-porch = <96>;
		qcom,mdss-dsi-h-pulse-width = <96>;
		qcom,mdss-dsi-h-sync-skew = <0>;
		qcom,mdss-dsi-v-front-porch = <9>;
		qcom,mdss-dsi-v-pulse-width = <3>;
		qcom,mdss-dsi-v-back-porch = <13>;
		qcom,mdss-dsi-h-left-border = <0>;
		qcom,mdss-dsi-h-right-border = <0>;
		qcom,mdss-dsi-v-top-border = <0>;
		qcom,mdss-dsi-v-bottom-border = <0>;
		qcom,mdss-dsi-bpp = <24>;
		qcom,mdss-dsi-color-order = <0>;
		qcom,mdss-dsi-underflow-color = <0xff>;
		qcom,mdss-dsi-border-color = <0>;
		qcom,mdss-dsi-on-command = [39 01 00 00 00 00 06 F0 55 AA 52 08 00
39 01 00 00 00 00 03 B1 FC 04     
39 01 00 00 00 00 02 B3 80
39 01 00 00 00 00 03 B7 70 70
39 01 00 00 00 00 05 B8 01 04 04 04
39 01 00 00 00 00 07 C9 67 06 0D 1A 17 00
39 01 00 00 00 00 06 F0 55 AA 52 08 01
39 01 00 00 00 00 02 B0 0F
39 01 00 00 00 00 02 B6 44
39 01 00 00 00 00 02 B1 0F
39 01 00 00 00 00 02 B7 44
39 01 00 00 00 00 02 B2 00
39 01 00 00 00 00 02 B8 15
39 01 00 00 00 00 02 B3 0A
39 01 00 00 00 00 02 B9 23
39 01 00 00 00 00 02 b4 08
39 01 00 00 00 00 02 BA 24
39 01 00 00 00 00 04 BC 00 70 00
39 01 00 00 00 00 04 BD 00 70 00
39 01 00 00 00 00 02 C1 01
39 01 00 00 00 00 02 BE 51
39 01 00 00 00 00 02 BF 51
39 01 00 00 00 00 02 cf 04
39 01 00 00 00 00 11 D1 00 A7 00 B5 00 CC 00 E2 00 F2 01 0A 01 26 01 4E 
39 01 00 00 00 00 11 D2 01 6D 01 9E  01 C6 02 05  02 37 02 39 02 6A 02 9F 
39 01 00 00 00 00 11 D3 02 C3 02 F0  03 11 03 3C  03 58 03 7D 03 96 03 B6 
39 01 00 00 00 00 05 D4 03 E8 03 FF                                                                                                                  
39 01 00 00 00 00 02 35 00 
05 01 00 00 78 00 02 11 00
05 01 00 00 0a 00 02 29 00];
		qcom,mdss-dsi-off-command = [05 01 00 00 0a 00 02 28 00
					05 01 00 00 78 00 02 10 00];
		qcom,mdss-dsi-on-command-state = "dsi_lp_mode";
		qcom,mdss-dsi-off-command-state = "dsi_lp_mode";
		qcom,mdss-dsi-h-sync-pulse = <1>;
		//qcom,mdss-dsi-traffic-mode = "burst_mode";
		qcom,mdss-dsi-lane-map = "lane_map_3012";
		qcom,mdss-dsi-bllp-eof-power-mode;
		qcom,mdss-dsi-bllp-power-mode;
		qcom,mdss-dsi-lane-0-state;
		qcom,mdss-dsi-lane-1-state;
		qcom,mdss-dsi-panel-timings = [8e 22 18 00 4a 4c 1C 26 1a 03 04 00];
		qcom,mdss-dsi-t-clk-post = <0x04>;
		qcom,mdss-dsi-t-clk-pre = <0x1d>;
		qcom,mdss-dsi-bl-min-level = <1>;
		qcom,mdss-dsi-bl-max-level = <30>;
		qcom,mdss-dsi-dma-trigger = "trigger_sw";
		qcom,mdss-dsi-mdp-trigger = "none";
		qcom,mdss-dsi-bl-cmd-gpio =  <&msmgpio 33 0>;
		qcom,mdss-dsi-bl-pmic-control-type = "bl_ctrl_gpio";
		qcom,mdss-dsi-reset-sequence = <1 20>, <0 20>, <1 20>;

	};
};
