/* Copyright (c) 2012, Code Aurora Forum. All rights reserved.
 *
 * This program is free software; you can redistribute it and/or modify
 * it under the terms of the GNU General Public License version 2 and
 * only version 2 as published by the Free Software Foundation.
 *
 * This program is distributed in the hope that it will be useful,
 * but WITHOUT ANY WARRANTY; without even the implied warranty of
 * MERCHANTABILITY or FITNESS FOR A PARTICULAR PURPOSE.  See the
 * GNU General Public License for more details.
 */

/*---------------------------------------------------------------------------
 * This file is autogenerated file using gcdb parser. Please do not edit it.
 * Update input XML file to add a new entry or update variable in this file
 * VERSION = "1.0"
 *---------------------------------------------------------------------------*/
&mdss_mdp {

        dsi_r61318_cpt_720p_vid: qcom,mdss_dsi_yushun_r61318_cpt_5p0_720p_video{
             
        qcom,mdss-dsi-panel-name =  "zteYUSHUN(R61318)CPT_720*1280_5.0Inch";             
		qcom,cont-splash-enabled; 		
 		qcom,mdss-dsi-panel-controller = <&mdss_dsi0>;
		qcom,mdss-dsi-panel-type = "dsi_video_mode";
		qcom,mdss-dsi-panel-destination = "display_1";
		qcom,mdss-dsi-panel-framerate = <60>;
		qcom,mdss-dsi-virtual-channel-id = <0>;
		qcom,mdss-dsi-stream = <0>;
		qcom,mdss-dsi-panel-width = <720>;
		qcom,mdss-dsi-panel-height = <1280>;
		qcom,mdss-dsi-h-front-porch = <100>;
		qcom,mdss-dsi-h-back-porch = <100>;
		qcom,mdss-dsi-h-pulse-width =  <12>;
		qcom,mdss-dsi-h-sync-skew = <0>;
		qcom,mdss-dsi-v-front-porch = <16>;
		qcom,mdss-dsi-v-back-porch = <10>;		
		qcom,mdss-dsi-v-pulse-width = <2>;
		qcom,mdss-dsi-h-left-border = <0>;
		qcom,mdss-dsi-h-right-border = <0>;
		qcom,mdss-dsi-v-top-border = <0>;
		qcom,mdss-dsi-v-bottom-border = <0>;
		qcom,mdss-dsi-bpp = <24>;
		qcom,mdss-dsi-color-order = <0>;
		qcom,mdss-dsi-underflow-color = <0xff>;
		qcom,mdss-dsi-border-color = <0>;
		
		qcom,mdss-dsi-h-sync-pulse = <0>;
		qcom,mdss-dsi-traffic-mode = <1>;
		qcom,mdss-dsi-lane-map = <0>;
		qcom,mdss-dsi-bllp-eof-power-mode;
		qcom,mdss-dsi-bllp-power-mode;
		qcom,mdss-dsi-lane-0-state;
		qcom,mdss-dsi-lane-1-state;
		qcom,mdss-dsi-lane-2-state;
		qcom,mdss-dsi-lane-3-state;
		qcom,mdss-dsi-panel-timings =[32 1c 12 00 40 42 16 1e 14 03 04 a0];
		qcom,mdss-dsi-t-clk-post = <0x04>;
		qcom,mdss-dsi-t-clk-pre = <0x18>;
		qcom,mdss-dsi-bl-min-level = <1>;
		qcom,mdss-dsi-bl-max-level = <31>;
		qcom,mdss-dsi-dma-trigger = <0x04>;
		qcom,mdss-dsi-mdp-trigger = <0x0>;
		qcom,mdss-dsi-bl-pmic-control-type = "bl_ctrl_gpio";
		qcom,mdss-dsi-bl-cmd-gpio = <&msmgpio 1 0>;
		qcom,mdss-dsi-reset-sequence = <1 20>, <0 10>, <1 20>;
		qcom,mdss-pan-physical-width-dimension = <64>;
		qcom,mdss-pan-physical-height-dimension = <113>;
		
                qcom,mdss-dsi-on-command= [
				    
				29 01 00 00 00 00 02 B0 00

				29 01 00 00 00 00 02 B3 00 

				29 01 00 00 00 00 02 B6 32  

				29 01 00 00 00 00 07 C0 23 B2 10 10 02 7F  

				29 01 00 00 00 00 08 C1 A0 70 60 60 01 01 F0  

				29 01 00 00 00 00 04 C4 BC B0 01  

				29 01 00 00 00 00 04 C5 07 00 37  

				29 01 00 00 00 00 02 C6  21  

				29 01 00 00 00 00 1D C8 61 4E 42 AA 90 5A 6B AD B5 D6 5A 6B 85 51 CA 08 6B AD B5 D6 5A 6B AD 95 14 85 D2 31  

				29 01 00 00 00 00 1F CA 01 08 0C 11 18 1C 20 20 21 1F 1B 13 0E 09 05 01 08 0C 11 18 1C 20 20 21 1F 1B 13 0E 09 05  

				29 01 00 00 00 00 14 CB 00 00 00 00 00 FC 00 00 00 00 00 FC 00 00 00 00  00 FC 00  

				29 01 00 00 00 00 04 D0 05 8B 42  

				29 01 00 00 00 00 02 D1 03  

				29 01 00 00 00 00 03 D2 03 1F  

				29 01 00 00 00 00 03 D3 11 33  

				29 01 00 00 00 00 02 E5 02  

				29 01 00 00 00 00 02 D4 45  

				29 01 00 00 00 00 03 D5 32 32  

				29 01 00 00 00 00 02 D6 01  

				05 01 00 00 78 00 02 11 00 
				
				05 01 00 00 78 00 02 29 00
								
				];
								
                qcom,mdss-dsi-on-command-state = "dsi_lp_mode";
                qcom,mdss-dsi-off-command = [05 01 00 00 32 00 02 28 00
                                       05 01 00 00 78 00 02 10 00];
                qcom,mdss-dsi-off-command-state = "dsi_hs_mode";
        };
};