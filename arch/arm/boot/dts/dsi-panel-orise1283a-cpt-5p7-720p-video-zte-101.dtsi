/* Copyright (c) 2012, Code Aurora Forum. All rights reserved.
 *
 * This program is free software; you can redistribute it and/or modify
 * it under the terms of the GNU General Public License version 2 and
 * only version 2 as published by the Free Software Foundation.
 *
 * This program is distributed in the hope that it will be useful,
 * but WITHOUT ANY WARRANTY; without even the implied warranty of
 * MERCHANTABILITY or FITNESS FOR A PARTICULAR PURPOSE.  See the
 * GNU General Public License for more details.
 */

/*---------------------------------------------------------------------------
 * This file is autogenerated file using gcdb parser. Please do not edit it.
 * Update input XML file to add a new entry or update variable in this file
 * VERSION = "1.0"
 *---------------------------------------------------------------------------*/
&mdss_mdp {

	dsi_orise1283a_cpt_5p7_720p_vid:qcom,mdss_dsi_orise1283a_cpt_5p7_720p_video_101 {
		qcom,mdss-dsi-panel-name = "zteCPT(OTM1283A)_720*1280_5.7Inch";
		qcom,cont-splash-enabled;
		
		zte,lcd-product = <101>;
		

		qcom,mdss-dsi-panel-controller = <&mdss_dsi0>;
		qcom,mdss-dsi-panel-type = "dsi_video_mode";
		qcom,mdss-dsi-panel-destination = "display_1";
		qcom,mdss-dsi-panel-framerate = <60>;
		qcom,mdss-dsi-virtual-channel-id = <0>;
		qcom,mdss-dsi-stream = <0>;
		qcom,mdss-dsi-panel-width = <720>;
		qcom,mdss-dsi-panel-height = <1280>;
		qcom,mdss-dsi-h-front-porch = <80>;
		qcom,mdss-dsi-h-back-porch = <80>;
		qcom,mdss-dsi-h-pulse-width = <12>;
		qcom,mdss-dsi-h-sync-skew = <0>;		
		qcom,mdss-dsi-v-front-porch = <6>;
		qcom,mdss-dsi-v-back-porch = <12>;
		qcom,mdss-dsi-v-pulse-width = <4>;
		qcom,mdss-dsi-h-left-border = <0>;
		qcom,mdss-dsi-h-right-border = <0>;
		qcom,mdss-dsi-v-top-border = <0>;
		qcom,mdss-dsi-v-bottom-border = <0>;
		qcom,mdss-dsi-bpp = <24>;
		qcom,mdss-dsi-color-order = <0>;
		qcom,mdss-dsi-underflow-color = <0xff>;
		qcom,mdss-dsi-border-color = <0>;
		
		qcom,mdss-dsi-h-sync-pulse = <0>;
		qcom,mdss-dsi-traffic-mode = <1>;
		qcom,mdss-dsi-lane-map = <0>;
		qcom,mdss-dsi-bllp-eof-power-mode;
		qcom,mdss-dsi-bllp-power-mode;
		qcom,mdss-dsi-lane-0-state;
		qcom,mdss-dsi-lane-1-state;
		qcom,mdss-dsi-lane-2-state;
		qcom,mdss-dsi-lane-3-state;
		qcom,mdss-dsi-panel-timings =[6b 1a 10 00 3e 40 16 1e  15 03 04 a0];
		
		qcom,mdss-dsi-t-clk-post = <0x04>;
		qcom,mdss-dsi-t-clk-pre = <0x18>;
		qcom,mdss-dsi-bl-min-level = <1>;
		qcom,mdss-dsi-bl-max-level = <31>;
		qcom,mdss-dsi-dma-trigger = <0x04>;
		qcom,mdss-dsi-mdp-trigger = <0x0>;
		qcom,mdss-dsi-bl-pmic-control-type = "bl_ctrl_gpio";
		qcom,mdss-dsi-bl-cmd-gpio = <&msmgpio 23 0>;
		qcom,mdss-dsi-reset-sequence = <1 20>, <0 10>, <1 20>;		
		qcom,mdss-pan-physical-width-dimension = <71>;
		qcom,mdss-pan-physical-height-dimension = <127>;
		qcom,mdss-dsi-on-command = [
				39 01 00 00 00 00 02 00 00                                                                             
				39 01 00 00 00 00 04 ff 12 83 01 	//EXTC=1                                                         
				39 01 00 00 00 00 02 00 80 	            //Orise mode enable                                            
				39 01 00 00 00 00 03 ff 12 83                                                                        
				39 01 00 00 00 00 02 00 80              //TCON Setting                                                 
				39 01 00 00 00 00 0a c0 00 64 00 10 10 00 64 10 10                                     
				39 01 00 00 00 00 02 00 90              //Panel Timing Setting                                         
				39 01 00 00 00 00 07 c0 00 5c 00 01 00 04                                                    
				39 01 00 00 00 00 02 00 a4              //source pre.                                                  
				39 01 00 00 00 00 02 c0 22                                                                             
				39 01 00 00 00 00 02 00 b3              //Interval Scan Frame: 0 frame  column inversion               
				39 01 00 00 00 00 03 c0 00 50                                                                        
				39 01 00 00 00 00 02 00 81              //frame rate:60Hz                                              
				39 01 00 00 00 00 02 c1 55                                                                             
				39 01 00 00 00 00 02 00 90              //clock delay for data latch                                   
				39 01 00 00 00 00 02 c4 49                                                                             
				39 01 00 00 00 00 02 00 a0              //dcdc setting                                                 
				39 01 00 00 00 00 0f c4 05 10 06 02 05 15 10 05 10 07 02 05 15 10            
				39 01 00 00 00 00 02 00 b0              //clamp voltage setting                                        
				39 01 00 00 00 00 03 c4 00 00                                                                        
				39 01 00 00 00 00 02 00 91              //VGH=15V  VGL=-10V  pump ratio:VGH=6x  VGL=-5x                
				39 01 00 00 00 00 03 c5 46 40                                                                        
				39 01 00 00 00 00 02 00 00              //GVDD=4.87V  NGVDD=-4.87V                                     
				39 01 00 00 00 00 03 d8 bc bc                                                                        
				39 01 00 00 00 00 02 00 00              //VCOMDC=-0.9                                                  
				39 01 00 00 00 00 02 d9 44                                                                             
				39 01 00 00 00 00 02 00 81              //source bias 0.75uA                                           
				39 01 00 00 00 00 02 c4 82                                                                             
				39 01 00 00 00 00 02 00 b0              //VDD_18V=1.6V  LVDSVDD=1.55V                                  
				39 01 00 00 00 00 03 c5 04 b8                                                                        
				39 01 00 00 00 00 02 00 bb              //LVD voltage level setting                                    
				39 01 00 00 00 00 02 c5 80                                                                             
				39 01 00 00 00 00 02 00 82 		// chopper 0: frame 2: line 4: disable                                   
				39 01 00 00 00 00 02 C4 02                                                                             
				39 01 00 00 00 00 02 00 c6 		// debounce                                                              
				39 01 00 00 00 00 02 B0 03                                                                             
				39 01 00 00 00 00 02 00 00              //ID1                                                          
				39 01 00 00 00 00 02 d0 40                                                                             
				39 01 00 00 00 00 02 00 00              //ID2  ID3                                                     
				39 01 00 00 00 00 03 d1 00 00                                                                        
				39 01 00 00 00 00 02 00 80              //panel timing state control                                   
				39 01 00 00 00 00 0c cb 00 00 00 00 00 00 00 00 00 00 00                           
				39 01 00 00 00 00 02 00 90              //panel timing state control                                   
				39 01 00 00 00 00 10 cb 00 00 00 00 00 00 00 00 00 00 00 00 00 00 00       
				39 01 00 00 00 00 02 00 a0              //panel timing state control                                   
				39 01 00 00 00 00 10 cb 00 00 00 00 00 00 00 00 00 00 00 00 00 00 00       
				39 01 00 00 00 00 02 00 b0              //panel timing state control                                   
				39 01 00 00 00 00 10 cb 00 00 00 00 00 00 00 00 00 00 00 00 00 00 00       
				39 01 00 00 00 00 02 00 c0              //panel timing state control                                   
				39 01 00 00 00 00 10 cb 05 00 05 05 05 05 00 00 00 00 00 00 00 00 00       
				39 01 00 00 00 00 02 00 d0              //panel timing state control                                   
				39 01 00 00 00 00 10 cb 00 00 00 05 00 05 05 05 00 05 05 05 05 00 00       
				39 01 00 00 00 00 02 00 e0              //panel timing state control                                   
				39 01 00 00 00 00 0f cb 00 00 00 00 00 00 00 00 00 00 05 00 05 05            
				39 01 00 00 00 00 02 00 f0              //panel timing state control                                   
				39 01 00 00 00 00 0c cb ff ff ff ff ff ff ff ff ff ff ff                           
				39 01 00 00 00 00 02 00 80              //panel pad mapping control                                    
				39 01 00 00 00 00 10 cc 02 00 0a 0e 0c 10 00 00 00 00 00 00 00 00 00       
				39 01 00 00 00 00 02 00 90              //panel pad mapping control                                    
				39 01 00 00 00 00 10 cc 00 00 00 06 00 2e 2d 01 00 09 0d 0b 0f 00 00       
				39 01 00 00 00 00 02 00 a0              //panel pad mapping control                                    
				39 01 00 00 00 00 0f cc 00 00 00 00 00 00 00 00 00 00 05 00 2e 2d            
				39 01 00 00 00 00 02 00 b0              //panel pad mapping control                                    
				39 01 00 00 00 00 10 cc 05 00 0f 0b 0d 09 00 00 00 00 00 00 00 00 00       
				39 01 00 00 00 00 02 00 c0              //panel pad mapping control                                    
				39 01 00 00 00 00 10 cc 00 00 00 01 00 2d 2e 06 00 10 0c 0e 0a 00 00       
				39 01 00 00 00 00 02 00 d0              //panel pad mapping control                                    
				39 01 00 00 00 00 0f cc 00 00 00 00 00 00 00 00 00 00 02 00 2d 2e            
				39 01 00 00 00 00 02 00 80              //panel VST setting                                            
				39 01 00 00 00 00 0d ce 87 03 18 86 03 18 00 00 00 00 00 00                      
				39 01 00 00 00 00 02 00 90              //panel VEND setting                                           
				39 01 00 00 00 00 0f ce 34 fe 18 34 ff 18 00 00 00 00 00 00 00 00            
				39 01 00 00 00 00 02 00 a0              //panel CLKA1/2 setting                                        
				39 01 00 00 00 00 0f ce 38 03 05 00 00 18 00 38 02 05 01 00 18 00            
				39 01 00 00 00 00 02 00 b0              //panel CLKA3/4 setting                                        
				39 01 00 00 00 00 0f ce 38 01 05 02 00 18 00 38 00 05 03 00 18 00            
				39 01 00 00 00 00 02 00 c0              //panel CLKb1/2 setting                                        
				39 01 00 00 00 00 0f ce 30 00 05 04 00 18 00 30 01 05 05 00 18 00            
				39 01 00 00 00 00 02 00 d0              //panel CLKb3/4 setting                                        
				39 01 00 00 00 00 0f ce 30 02 05 06 00 18 00 30 03 05 07 00 18 00            
				39 01 00 00 00 00 02 00 80              //panel CLKc1/2 setting                                        
				39 01 00 00 00 00 0f cf 00 00 00 00 00 00 00 00 00 00 00 00 00 00            
				39 01 00 00 00 00 02 00 90              //panel CLKc3/4 setting                                        
				39 01 00 00 00 00 0f cf 00 00 00 00 00 00 00 00 00 00 00 00 00 00            
				39 01 00 00 00 00 02 00 a0              //panel CLKd1/2 setting                                        
				39 01 00 00 00 00 0f cf 00 00 00 00 00 00 00 00 00 00 00 00 00 00            
				39 01 00 00 00 00 02 00 b0              //panel CLKd3/4 setting                                        
				39 01 00 00 00 00 0f cf 00 00 00 00 00 00 00 00 00 00 00 00 00 00            
				39 01 00 00 00 00 02 00 c0              //panel ECLK setting                                           
				39 01 00 00 00 00 0c cf 01 01 20 20 00 00 01 81 00 03 08  //gate pre. ena.         
				39 01 00 00 00 00 02 00 b5              //TCON_GOA_OUT Setting                                         
				39 01 00 00 00 00 07 c5 37 f1 fd 37 f1 fd                                                    
				39 01 00 00 00 00 02 00 90              //Mode-3                                                       
				39 01 00 00 00 00 05 f5 02 11 02 11                                                              
				39 01 00 00 00 00 02 00 90              //3xVPNL                                                       
				39 01 00 00 00 00 02 c5 50                                                                             
				39 01 00 00 00 00 02 00 94              //2xVPNL                                                       
				39 01 00 00 00 00 02 c5 66                                                                             
				39 01 00 00 00 00 02 00 b2              //VGLO1                                                        
				39 01 00 00 00 00 03 f5 00 00                                                                        
				39 01 00 00 00 00 02 00 b4              //VGLO1_S                                                      
				39 01 00 00 00 00 03 f5 00 00                                                                        
				39 01 00 00 00 00 02 00 b6              //VGLO2                                                        
				39 01 00 00 00 00 03 f5 00 00                                                                        
				39 01 00 00 00 00 02 00 b8              //VGLO2_S                                                      
				39 01 00 00 00 00 03 f5 00 00                                                                        
				39 01 00 00 00 00 02 00 b4              //VGLO1/2 Pull low setting                                     
				39 01 00 00 00 00 02 c5 c0 		//d[7] vglo1 d[6] vglo2 => 0: pull vss  1: pull vgl                      
				39 01 00 00 00 00 02 00 b2              //C31 cap. not remove                                          
				39 01 00 00 00 00 02 c5 40                                                                             
				39 01 00 00 00 00 02 00 00                                                                             
				39 01 00 00 00 00 11 E1 00 16 1d 0e 07 10 0c 0c 03 06 0b 07 0e 12 0d 06  
				39 01 00 00 00 00 02 00 00                                                                             
				39 01 00 00 00 00 11 E2 00 16 1d 0e 07 10 0c 0c 03 06 0b 07 0e 12 0d 06 
/* color enhance */                               
                                15 01 00 00 00 00 02 00 a0
                                39 01 00 00 00 00 0d d6 01 cd 01 cd 01 cd 01 cd 01 cd 01 cd
                                15 01 00 00 00 00 02 00 B0
                                39 01 00 00 00 00 0d d6 01 cd 01 cd 01 cd 01 cd 01 cd 01 cd
                                15 01 00 00 00 00 02 00 c0
                                39 01 00 00 00 00 0d d6 89 11 89 89 11 89 89 11 89 89 11 89
                                15 01 00 00 00 00 02 00 d0
                                39 01 00 00 00 00 07 d6 89 11 89 89 11 89
                                15 01 00 00 00 00 02 00 E0
                                39 01 00 00 00 00 0d d6 44 11 44 44 11 44 44 11 44 44 11 44
                                15 01 00 00 00 00 02 00 F0
                                39 01 00 00 00 00 07 d6 44 11 44 44 11 44
                                15 01 00 00 00 00 02 00 90
                                15 01 00 00 00 00 02 d6 80
                                15 01 00 00 00 00 02 00 00
                                15 01 00 00 00 00 02 55 B0
                                15 01 00 00 00 00 02 00 81
                                39 01 00 00 00 00 03 d6 00 ff
/**/			 
				39 01 00 00 00 00 02 00 00              //Orise mode disable                                           
				39 01 00 00 00 00 04 ff ff ff ff 
                      
                        
				05 01 00 00 78 00 02 11 00 
				05 01 00 00 0a 00 02 29 00];
		qcom,mdss-dsi-on-command-state = "dsi_lp_mode";
		qcom,mdss-dsi-off-command = [05 01 00 00 32 00 02 28 00
					05 01 00 00 78 00 02 10 00];
		qcom,mdss-dsi-off-command-state = "dsi_hs_mode";
	};
};









































































































































