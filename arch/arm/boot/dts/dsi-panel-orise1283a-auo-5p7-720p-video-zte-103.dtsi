/* Copyright (c) 2012, Code Aurora Forum. All rights reserved.
 *
 * This program is free software; you can redistribute it and/or modify
 * it under the terms of the GNU General Public License version 2 and
 * only version 2 as published by the Free Software Foundation.
 *
 * This program is distributed in the hope that it will be useful,
 * but WITHOUT ANY WARRANTY; without even the implied warranty of
 * MERCHANTABILITY or FITNESS FOR A PARTICULAR PURPOSE.  See the
 * GNU General Public License for more details.
 */

/*---------------------------------------------------------------------------
 * This file is autogenerated file using gcdb parser. Please do not edit it.
 * Update input XML file to add a new entry or update variable in this file
 * VERSION = "1.0"
 *---------------------------------------------------------------------------*/
&mdss_mdp {

        dsi_orise1283a_auo_5p7_720p_video_103:qcom,mdss_dsi_orise1283a_auo_5p7_720p_video_103 {
         
              qcom,mdss-dsi-panel-name =  "zteLEAD_AUO(OTM1283A)_720*1280_5.7Inch-new";
		qcom,cont-splash-enabled;
              zte,lcd-product = <103>;
	

		qcom,mdss-dsi-panel-controller = <&mdss_dsi0>;
		qcom,mdss-dsi-panel-type = "dsi_video_mode";
		qcom,mdss-dsi-panel-destination = "display_1";
		qcom,mdss-dsi-panel-framerate = <60>;
		qcom,mdss-dsi-virtual-channel-id = <0>;
		qcom,mdss-dsi-stream = <0>;
		qcom,mdss-dsi-panel-width = <720>;
		qcom,mdss-dsi-panel-height = <1280>;
		qcom,mdss-dsi-h-front-porch = <80>;
		qcom,mdss-dsi-h-back-porch = <80>;
		qcom,mdss-dsi-h-pulse-width = <12>;
		qcom,mdss-dsi-h-sync-skew = <0>;
		qcom,mdss-dsi-v-front-porch = <6>;
		qcom,mdss-dsi-v-back-porch = <12>;		
		qcom,mdss-dsi-v-pulse-width = <4>;
		qcom,mdss-dsi-h-left-border = <0>;
		qcom,mdss-dsi-h-right-border = <0>;
		qcom,mdss-dsi-v-top-border = <0>;
		qcom,mdss-dsi-v-bottom-border = <0>;
		qcom,mdss-dsi-bpp = <24>;
		qcom,mdss-dsi-color-order = <0>;
		qcom,mdss-dsi-underflow-color = <0xff>;
		qcom,mdss-dsi-border-color = <0>;
		
		qcom,mdss-dsi-h-sync-pulse = <0>;
		qcom,mdss-dsi-traffic-mode = <1>;
		qcom,mdss-dsi-lane-map = <0>;
		qcom,mdss-dsi-bllp-eof-power-mode;
		qcom,mdss-dsi-bllp-power-mode;
		qcom,mdss-dsi-lane-0-state;
		qcom,mdss-dsi-lane-1-state;
		qcom,mdss-dsi-lane-2-state;
		qcom,mdss-dsi-lane-3-state;
		qcom,mdss-dsi-panel-timings =[6b 1a 10 00 3e 40 16 1e  15 03 04 a0];
		qcom,mdss-dsi-t-clk-post = <0x04>;
		qcom,mdss-dsi-t-clk-pre = <0x18>;
		qcom,mdss-dsi-bl-min-level = <1>;
		qcom,mdss-dsi-bl-max-level = <31>;
		qcom,mdss-dsi-dma-trigger = <0x04>;
		qcom,mdss-dsi-mdp-trigger = <0x0>;
		qcom,mdss-dsi-bl-pmic-control-type = "bl_ctrl_gpio";
		qcom,mdss-dsi-bl-cmd-gpio = <&msmgpio 23 0>;
		qcom,mdss-dsi-reset-sequence = <1 20>, <0 10>, <1 20>;
		qcom,mdss-pan-physical-width-dimension = <71>;
		qcom,mdss-pan-physical-height-dimension = <127>;

                qcom,mdss-dsi-on-command = [
        39 01 00 00 00 00 02 00 00
        39 01 00 00 00 00 04 FF 12 83 01
        39 01 00 00 00 00 02 00 80
        39 01 00 00 00 00 03 FF 12 83  
        39 01 00 00 00 00 02 00 80
        39 01 00 00 00 00 0a C0 00 64 00 10 10 00 64 10 10
        39 01 00 00 00 00 02 00 90
        39 01 00 00 00 00 07 C0 00 5C 00 01 00 04 
        39 01 00 00 00 00 02 00 A2
        39 01 00 00 00 00 04 C0 01 00 00
        39 01 00 00 00 00 02 00 B3 
        39 01 00 00 00 00 03 C0 00 50
        39 01 00 00 00 00 02 00 81  
        39 01 00 00 00 00 02 C1 66
        39 01 00 00 00 00 02 00 90  
        39 01 00 00 00 00 02 C4 49  
        39 01 00 00 00 00 02 00 81 
        39 01 00 00 00 00 02 C4 82  
        39 01 00 00 00 00 02 00 82 
        39 01 00 00 00 00 02 C4 02  				
        39 01 00 00 00 00 02 00 A0
        39 01 00 00 00 00 0f C4 05 10 04 02 05 15 11 05 10 07 02 05 15 11
        39 01 00 00 00 00 02 00 B0 
        39 01 00 00 00 00 03 C4 00 00
        39 01 00 00 00 00 02 00 91 
        39 01 00 00 00 00 03 C5 29 50   
        39 01 00 00 00 00 02 00 B0
        39 01 00 00 00 00 03 C5 04 38
        39 01 00 00 00 00 02 00 BB 
        39 01 00 00 00 00 02 C5 80
        39 01 00 00 00 00 02 00 b9 
        39 01 00 00 00 00 02 b0 51
        39 01 00 00 00 00 02 00 00 
        39 01 00 00 00 00 02 D0 40        
        39 01 00 00 00 00 02 00 00
        39 01 00 00 00 00 03 D1 00 00
        39 01 00 00 00 00 02 00 80 
        39 01 00 00 00 00 02 C4 00
        39 01 00 00 00 00 02 00 98 
        39 01 00 00 00 00 02 C5 10 
        39 01 00 00 00 00 02 00 81
        39 01 00 00 00 00 02 F5 15 
        39 01 00 00 00 00 02 00 83
        39 01 00 00 00 00 02 F5 15 
        39 01 00 00 00 00 02 00 85
        39 01 00 00 00 00 02 F5 15 
        39 01 00 00 00 00 02 00 87
        39 01 00 00 00 00 02 F5 15 
        39 01 00 00 00 00 02 00 89
        39 01 00 00 00 00 02 F5 15 
        39 01 00 00 00 00 02 00 8B
        39 01 00 00 00 00 02 F5 15 
        39 01 00 00 00 00 02 00 95
        39 01 00 00 00 00 02 F5 15 
        39 01 00 00 00 00 02 00 97
        39 01 00 00 00 00 02 F5 15 
        39 01 00 00 00 00 02 00 99
        39 01 00 00 00 00 02 F5 15 
        39 01 00 00 00 00 02 00 A1
        39 01 00 00 00 00 02 F5 15 
        39 01 00 00 00 00 02 00 A3
        39 01 00 00 00 00 02 F5 15 
        39 01 00 00 00 00 02 00 A5
        39 01 00 00 00 00 02 F5 15 
        39 01 00 00 00 00 02 00 A7
        39 01 00 00 00 00 02 F5 15 
        39 01 00 00 00 00 02 00 AB
        39 01 00 00 00 00 02 F5 18
        39 01 00 00 00 00 02 00 94 
        39 01 00 00 00 00 02 F5 02
        39 01 00 00 00 00 02 00 BA 
        39 01 00 00 00 00 02 F5 03
        39 01 00 00 00 00 02 00 B1
        39 01 00 00 00 00 0e F5 15 00 00 00 00 00 00 00 00 03 15 08 15
        39 01 00 00 00 00 02 00 B4 
        39 01 00 00 00 00 02 C5 C0
        39 01 00 00 00 00 02 00 90 
        39 01 00 00 00 00 05 F5 02 11 02 11
        39 01 00 00 00 00 02 00 90 
        39 01 00 00 00 00 02 C5 50
        39 01 00 00 00 00 02 00 94 
        39 01 00 00 00 00 02 C5 66
        39 01 00 00 00 00 02 00 80 
        39 01 00 00 00 00 0c CB 00 00 00 00 00 00 00 00 00 00 00
        39 01 00 00 00 00 02 00 90 
        39 01 00 00 00 00 10 CB 00 00 00 00 00 00 00 00 00 00 00 FF 00 FF 00
        39 01 00 00 00 00 02 00 A0 
        39 01 00 00 00 00 10 CB FF 00 FF 00 00 00 00 00 00 00 00 00 00 00 00
        39 01 00 00 00 00 02 00 B0 
        39 01 00 00 00 00 10 CB 00 00 00 FF 00 FF 00 FF 00 FF 00 00 00 00 00
        39 01 00 00 00 00 02 00 C0 
        39 01 00 00 00 00 10 CB 00 00 00 00 00 00 00 05 05 00 05 05 05 05 05
        39 01 00 00 00 00 02 00 D0 
        39 01 00 00 00 00 10 CB 05 05 05 05 05 00 00 00 00 00 00 00 00 00 05
        39 01 00 00 00 00 02 00 E0 
        39 01 00 00 00 00 0f CB 05 00 05 05 05 05 05 05 05 05 05 05 00 00
        39 01 00 00 00 00 02 00 F0 
        39 01 00 00 00 00 0c CB FF FF FF FF FF FF FF FF FF FF FF
        39 01 00 00 00 00 02 00 80 
        39 01 00 00 00 00 10 CC 00 00 00 00 00 00 00 05 07 00 0D 09 0F 0B 15
        39 01 00 00 00 00 02 00 90 
        39 01 00 00 00 00 10 CC 11 17 13 01 03 00 00 00 00 00 00 00 00 00 06
        39 01 00 00 00 00 02 00 A0 
        39 01 00 00 00 00 0f CC 08 00 0E 0A 10 0C 16 12 18 14 02 04 00 00
        39 01 00 00 00 00 02 00 B0 
        39 01 00 00 00 00 10 CC 00 00 00 00 00 00 00 04 02 00 0C 10 0A 0E 18
        39 01 00 00 00 00 02 00 C0 
        39 01 00 00 00 00 10 CC 14 16 12 08 06 00 00 00 00 00 00 00 00 00 03
        39 01 00 00 00 00 02 00 D0 
        39 01 00 00 00 00 0f CC 01 00 0B 0F 09 0D 17 13 15 11 07 05 00 00
        39 01 00 00 00 00 02 00 80 
        39 01 00 00 00 00 0d CE 87 03 28 86 03 28 85 03 28 84 03 28
        39 01 00 00 00 00 02 00 90 
        39 01 00 00 00 00 0f CE 34 FC 28 34 FD 28 34 FE 28 34 FF 28 00 00
        39 01 00 00 00 00 02 00 A0 
        39 01 00 00 00 00 0f CE 38 07 05 00 00 28 00 38 06 05 01 00 28 00
        39 01 00 00 00 00 02 00 B0 
        39 01 00 00 00 00 0f CE 38 05 05 02 00 28 00 38 04 05 03 00 28 00
        39 01 00 00 00 00 02 00 C0 
        39 01 00 00 00 00 0f CE 38 03 05 04 00 28 00 38 02 05 05 00 28 00
        39 01 00 00 00 00 02 00 D0 
        39 01 00 00 00 00 0f CE 38 01 05 06 00 28 00 38 00 05 07 00 28 00
        39 01 00 00 00 00 02 00 80 
        39 01 00 00 00 00 0f CF 38 07 05 00 00 18 25 38 06 05 01 00 18 25
        39 01 00 00 00 00 02 00 90 
        39 01 00 00 00 00 0f CF 38 05 05 02 00 18 25 38 04 05 03 00 18 25
        39 01 00 00 00 00 02 00 A0 
        39 01 00 00 00 00 0f CF 38 03 05 04 00 18 25 38 02 05 05 00 18 25
        39 01 00 00 00 00 02 00 B0 
        39 01 00 00 00 00 0f CF 38 01 05 06 00 18 25 38 00 05 07 00 18 25
        39 01 00 00 00 00 02 00 C0
        39 01 00 00 00 00 0c CF 01 01 20 20 00 00 01 81 00 03 08   
	 39 01 00 00 00 00 02 00 00
	 39 01 00 00 00 00 03 d8 84 84
	 39 01 00 00 00 00 02 00 00
	 39 01 00 00 00 00 02 d9 35				
        39 01 00 00 00 00 02 00 00 
        39 01 00 00 00 00 11 E1 0A 15 1B 0E 06 10 0B 0A 04 07 0B 07 0F 11 0C 06     
        39 01 00 00 00 00 02 00 00 
        39 01 00 00 00 00 11 E2 0A 15 1B 0E 06 10 0B 0A 04 07 0C 07 0F 11 0C 06                         
        39 01 00 00 00 00 02 00 00 
        39 01 00 00 00 00 04 FF FF FF FF
/* color enhance  */                              
                                15 01 00 00 00 00 02 00 a0
                                39 01 00 00 00 00 0d d6 01 cd 01 cd 01 cd 01 cd 01 cd 01 cd
                                15 01 00 00 00 00 02 00 B0
                                39 01 00 00 00 00 0d d6 01 cd 01 cd 01 cd 01 cd 01 cd 01 cd
                                15 01 00 00 00 00 02 00 c0
                                39 01 00 00 00 00 0d d6 89 11 89 89 11 89 89 11 89 89 11 89
                                15 01 00 00 00 00 02 00 d0
                                39 01 00 00 00 00 07 d6 89 11 89 89 11 89
                                15 01 00 00 00 00 02 00 E0
                                39 01 00 00 00 00 0d d6 44 11 44 44 11 44 44 11 44 44 11 44
                                15 01 00 00 00 00 02 00 F0
                                39 01 00 00 00 00 07 d6 44 11 44 44 11 44
                                15 01 00 00 00 00 02 00 90                   
                                15 01 00 00 00 00 02 d6 80
                                15 01 00 00 00 00 02 00 00                   
                                15 01 00 00 00 00 02 55 B0
                                15 01 00 00 00 00 02 00 81                   
                                39 01 00 00 00 00 03 d6 00 ff
/**/	                      
                        
				05 01 00 00 78 00 02 11 00 
				05 01 00 00 78 00 02 29 00];
		qcom,mdss-dsi-on-command-state = "dsi_lp_mode";
		qcom,mdss-dsi-off-command = [05 01 00 00 32 00 02 28 00
					                 05 01 00 00 78 00 02 10 00];
                qcom,mdss-dsi-off-command-state = "dsi_hs_mode";
        };
};