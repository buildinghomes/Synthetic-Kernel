/* Copyright (c) 2012, Code Aurora Forum. All rights reserved.
 *
 * This program is free software; you can redistribute it and/or modify
 * it under the terms of the GNU General Public License version 2 and
 * only version 2 as published by the Free Software Foundation.
 *
 * This program is distributed in the hope that it will be useful,
 * but WITHOUT ANY WARRANTY; without even the implied warranty of
 * MERCHANTABILITY or FITNESS FOR A PARTICULAR PURPOSE.  See the
 * GNU General Public License for more details.
 */

/*---------------------------------------------------------------------------
 * This file is autogenerated file using gcdb parser. Please do not edit it.
 * Update input XML file to add a new entry or update variable in this file
 * VERSION = "1.0"
 *---------------------------------------------------------------------------*/
&mdss_mdp {

        dsi_orise1283a_boe_720p_vid: qcom,mdss_dsi_orise1283a_boe_5p7_720p_video_100 {
             
        qcom,mdss-dsi-panel-name =  "zteBOE(OTM1283A)_720*1280_5.7Inch";
             
		qcom,cont-splash-enabled;
        zte,lcd-product = <100>;
		
 		qcom,mdss-dsi-panel-controller = <&mdss_dsi0>;
		qcom,mdss-dsi-panel-type = "dsi_video_mode";
		qcom,mdss-dsi-panel-destination = "display_1";
		qcom,mdss-dsi-panel-framerate = <60>;
		qcom,mdss-dsi-virtual-channel-id = <0>;
		qcom,mdss-dsi-stream = <0>;
		qcom,mdss-dsi-panel-width = <720>;
		qcom,mdss-dsi-panel-height = <1280>;
		qcom,mdss-dsi-h-front-porch = <80>;
		qcom,mdss-dsi-h-back-porch = <80>;
		qcom,mdss-dsi-h-pulse-width = <12>;
		qcom,mdss-dsi-h-sync-skew = <0>;
		qcom,mdss-dsi-v-front-porch = <6>;
		qcom,mdss-dsi-v-back-porch = <12>;		
		qcom,mdss-dsi-v-pulse-width = <4>;
		qcom,mdss-dsi-h-left-border = <0>;
		qcom,mdss-dsi-h-right-border = <0>;
		qcom,mdss-dsi-v-top-border = <0>;
		qcom,mdss-dsi-v-bottom-border = <0>;
		qcom,mdss-dsi-bpp = <24>;
		qcom,mdss-dsi-color-order = <0>;
		qcom,mdss-dsi-underflow-color = <0xff>;
		qcom,mdss-dsi-border-color = <0>;
		
		qcom,mdss-dsi-h-sync-pulse = <0>;
		qcom,mdss-dsi-traffic-mode = <1>;
		qcom,mdss-dsi-lane-map = <0>;
		qcom,mdss-dsi-bllp-eof-power-mode;
		qcom,mdss-dsi-bllp-power-mode;
		qcom,mdss-dsi-lane-0-state;
		qcom,mdss-dsi-lane-1-state;
		qcom,mdss-dsi-lane-2-state;
		qcom,mdss-dsi-lane-3-state;
		qcom,mdss-dsi-lp11-init;
		qcom,mdss-dsi-panel-timings =[6b 1a 10 00 3e 40 16 1e  15 03 04 a0];
		qcom,mdss-dsi-t-clk-post = <0x04>;
		qcom,mdss-dsi-t-clk-pre = <0x18>;
		qcom,mdss-dsi-bl-min-level = <1>;
		qcom,mdss-dsi-bl-max-level = <31>;
		qcom,mdss-dsi-dma-trigger = <0x04>;
		qcom,mdss-dsi-mdp-trigger = <0x0>;
		qcom,mdss-dsi-bl-pmic-control-type = "bl_ctrl_gpio";
		qcom,mdss-dsi-bl-cmd-gpio = <&msmgpio 23 0>;
		qcom,mdss-dsi-reset-sequence = <1 20>, <0 10>, <1 20>;
		qcom,mdss-pan-physical-width-dimension = <71>;
		qcom,mdss-pan-physical-height-dimension = <127>;
                qcom,mdss-dsi-on-command= [
				    39 01 00 00 00 00 02 00 00	
                                39 01 00 00 00 00 04 FF 12 83 01
                                39 01 00 00 00 00 02 00 80
                                39 01 00 00 00 00 03 FF 12 83
                                39 01 00 00 00 00 02 00 80
                                39 01 00 00 00 00 0a C0 00 64 00 0F 11 00 64 0F 11
                                39 01 00 00 00 00 02 00 90
                                39 01 00 00 00 00 07 C0 00 55 00 01 00 04
                                39 01 00 00 00 00 02 00 A4
                                39 01 00 00 00 00 02 C0 00
                                39 01 00 00 00 00 02 00 B3
                                39 01 00 00 00 00 03 C0 00 50
                                39 01 00 00 00 00 02 00 81
                                39 01 00 00 00 00 02 C1 55
                                39 01 00 00 00 00 02 00 81
                                39 01 00 00 00 00 02 C4 82
                                39 01 00 00 00 00 02 00 82
                                39 01 00 00 00 00 02 C4 02
                                39 01 00 00 00 00 02 00 90
                                39 01 00 00 00 00 02 C4 49
                                39 01 00 00 00 00 02 00 C6
                                39 01 00 00 00 00 02 B0 03
                                39 01 00 00 00 00 02 00 90
                                39 01 00 00 00 00 05 F5 02 11 02 11
                                39 01 00 00 00 00 02 00 90
                                39 01 00 00 00 00 02 C5 50
                                39 01 00 00 00 00 02 00 94
                                39 01 00 00 00 00 02 C5 66
                                39 01 00 00 00 00 02 00 B2
                                39 01 00 00 00 00 03 F5 00 00
                                39 01 00 00 00 00 02 00 B4
                                39 01 00 00 00 00 03 F5 00 00
                                39 01 00 00 00 00 02 00 B6
                                39 01 00 00 00 00 03 F5 00 00
                                39 01 00 00 00 00 02 00 B8
                                39 01 00 00 00 00 03 F5 00 00
                                39 01 00 00 00 00 02 00 B2
                                39 01 00 00 00 00 02 C5 40
                                39 01 00 00 00 00 02 00 B4
                                39 01 00 00 00 00 02 C5 C0
                                39 01 00 00 00 00 02 00 94
                                39 01 00 00 00 00 02 F5 02
                                39 01 00 00 00 00 02 00 BA
                                39 01 00 00 00 00 02 F5 03
                                39 01 00 00 00 00 02 00 A0
                                39 01 00 00 00 00 0f C4 05 10 06 02 05 15 10 05 10 07 02 05 15 10
                                39 01 00 00 00 00 02 00 B0
                                39 01 00 00 00 00 03 C4 00 00
                                39 01 00 00 00 00 02 00 91
                                39 01 00 00 00 00 03 C5 19 50
                                39 01 00 00 00 00 02 00 00
                                39 01 00 00 00 00 03 D8 BC BC
                                39 01 00 00 00 00 02 00 B0
                                39 01 00 00 00 00 03 C5 04 B8
                                39 01 00 00 00 00 02 00 BB
                                39 01 00 00 00 00 02 C5 80
                                39 01 00 00 00 00 02 00 00
                                39 01 00 00 00 00 02 D0 40
                                39 01 00 00 00 00 02 00 00
                                39 01 00 00 00 00 03 D1 00 00
                                39 01 00 00 00 00 02 00 00
                                39 01 00 00 00 00 11 E1 05 12 19 0F 07 10 0C 0B 00 06 0C 06 0F 11 0C 05
                                39 01 00 00 00 00 02 00 00
                                39 01 00 00 00 00 11 E2 05 11 16 0D 05 0C 0C 0B 04 06 10 09 10 11 0C 05
                                39 01 00 00 00 00 02 00 80
                                39 01 00 00 00 00 0c CB 00 00 00 00 00 00 00 00 00 00 00
                                39 01 00 00 00 00 02 00 90
                                39 01 00 00 00 00 10 CB 00 00 00 00 00 00 00 00 00 00 00 00 00 00 00
                                39 01 00 00 00 00 02 00 A0
                                39 01 00 00 00 00 10 CB 00 00 00 00 00 00 00 00 00 00 00 00 00 00 00
                                39 01 00 00 00 00 02 00 B0
                                39 01 00 00 00 00 10 CB 00 00 00 00 00 00 00 00 00 00 00 00 00 00 00
                                39 01 00 00 00 00 02 00 C0
                                39 01 00 00 00 00 10 CB 05 05 05 05 05 05 00 00 00 00 00 00 00 00 00
                                39 01 00 00 00 00 02 00 D0
                                39 01 00 00 00 00 10 CB 00 00 00 00 00 05 05 05 05 05 05 05 05 00 00
                                39 01 00 00 00 00 02 00 E0
                                39 01 00 00 00 00 0f CB 00 00 00 00 00 00 00 00 00 00 00 00 05 05
                                39 01 00 00 00 00 02 00 F0
                                39 01 00 00 00 00 0c CB FF FF FF FF FF FF FF FF FF FF FF
                                39 01 00 00 00 00 02 00 80
                                39 01 00 00 00 00 10 CC 0A 0C 0E 10 02 04 00 00 00 00 00 00 00 00 00
                                39 01 00 00 00 00 02 00 90
                                39 01 00 00 00 00 10 CC 00 00 00 00 00 2E 2D 09 0B 0D 0F 01 03 00 00
                                39 01 00 00 00 00 02 00 A0
                                39 01 00 00 00 00 0f CC 00 00 00 00 00 00 00 00 00 00 00 00 2E 2D
                                39 01 00 00 00 00 02 00 B0
                                39 01 00 00 00 00 10 CC 0F 0D 0B 09 03 01 00 00 00 00 00 00 00 00 00
                                39 01 00 00 00 00 02 00 C0
                                39 01 00 00 00 00 10 CC 00 00 00 00 00 2D 2E 10 0E 0C 0A 04 02 00 00
                                39 01 00 00 00 00 02 00 D0
                                39 01 00 00 00 00 0f CC 00 00 00 00 00 00 00 00 00 00 00 00 2D 2E
                                39 01 00 00 00 00 02 00 80
                                39 01 00 00 00 00 0d CE 8D 03 00 8C 03 00 8B 03 00 8A 03 00
                                39 01 00 00 00 00 02 00 90
                                39 01 00 00 00 00 0f CE 00 00 00 00 00 00 00 00 00 00 00 00 00 00
                                39 01 00 00 00 00 02 00 A0
                                39 01 00 00 00 00 0f CE 38 0B 04 FC 00 10 10 38 0A 04 FD 00 10 10
                                39 01 00 00 00 00 02 00 B0
                                39 01 00 00 00 00 0f CE 38 09 04 FE 00 10 10 38 08 04 FF 00 10 10
                                39 01 00 00 00 00 02 00 C0
                                39 01 00 00 00 00 0f CE 38 07 05 00 00 10 10 38 06 05 01 00 10 10
                                39 01 00 00 00 00 02 00 D0
                                39 01 00 00 00 00 0f CE 38 05 05 02 00 10 10 38 04 05 03 00 10 10
                                39 01 00 00 00 00 02 00 80
                                39 01 00 00 00 00 0f CF 00 00 00 00 00 00 00 00 00 00 00 00 00 00
                                39 01 00 00 00 00 02 00 90
                                39 01 00 00 00 00 0f CF 00 00 00 00 00 00 00 00 00 00 00 00 00 00
                                39 01 00 00 00 00 02 00 A0
                                39 01 00 00 00 00 0f CF 00 00 00 00 00 00 00 00 00 00 00 00 00 00
                                39 01 00 00 00 00 02 00 B0
                                39 01 00 00 00 00 0f CF 00 00 00 00 00 00 00 00 00 00 00 00 00 00
                                39 01 00 00 00 00 02 00 C0
                                39 01 00 00 00 00 0c CF 01 01 20 20 00 00 01 02 00 00 08
                                39 01 00 00 00 00 02 00 B5
                                39 01 00 00 00 00 07 C5 33 F1 FF 33 F1 FF
                                39 01 00 00 00 00 02 00 00
                                39 01 00 00 00 00 02 36 00
                                39 01 00 00 00 00 02 00 00	//
                                39 01 00 00 00 00 04 FF FF FF FF //
/* color enhance start */
		
                                15 01 00 00 00 00 02 00 a0
                                39 01 00 00 00 00 0d d6 01 cd 01 cd 01 cd 01 cd 01 cd 01 cd
                                15 01 00 00 00 00 02 00 B0
                                39 01 00 00 00 00 0d d6 01 cd 01 cd 01 cd 01 cd 01 cd 01 cd
                                15 01 00 00 00 00 02 00 c0
                                39 01 00 00 00 00 0d d6 89 11 89 89 11 89 89 11 89 89 11 89
                                15 01 00 00 00 00 02 00 d0
                                39 01 00 00 00 00 07 d6 89 11 89 89 11 89
                                15 01 00 00 00 00 02 00 E0
                                39 01 00 00 00 00 0d d6 44 11 44 44 11 44 44 11 44 44 11 44
                                15 01 00 00 00 00 02 00 F0
                                39 01 00 00 00 00 07 d6 44 11 44 44 11 44
                                15 01 00 00 00 00 02 00 90
                                15 01 00 00 00 00 02 d6 80
                                15 01 00 00 00 00 02 00 00
                                15 01 00 00 00 00 02 55 B0
                                15 01 00 00 00 00 02 00 81
                                39 01 00 00 00 00 03 d6 09 ff
              
/* color enhance end*/

                                05 01 00 00 78 00 02 11 00 
                                05 01 00 00 0a 00 02 29 00];
                qcom,mdss-dsi-on-command-state = "dsi_lp_mode";
                qcom,mdss-dsi-off-command = [05 01 00 00 32 00 02 28 00
                                       05 01 00 00 78 00 02 10 00];
                qcom,mdss-dsi-off-command-state = "dsi_lp_mode";
        };
};